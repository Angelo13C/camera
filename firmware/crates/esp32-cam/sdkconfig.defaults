## firmware/crates/esp32-cam/sdkconfig.defaults
```kconfig
CONFIG_ESP32_SPIRAM_SUPPORT=y
CONFIG_ESP_MAIN_TASK_STACK_SIZE=15000

CONFIG_ESP_TASK_WDT_CHECK_IDLE_TASK_CPU0=n
CONFIG_ESP_TASK_WDT_CHECK_IDLE_TASK_CPU1=n
```
